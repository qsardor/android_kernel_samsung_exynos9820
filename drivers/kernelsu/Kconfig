## drivers/kernelsu/Kconfig
```kconfig
menu "KernelSU"

config KSU
	tristate "KernelSU function support"
	default y
	help
	  Enable kernel-level root privileges on Android System.
	  Requires CONFIG_KPROBES for kernel hooking support.
	  To compile as a module, choose M here: the
	  module will be called kernelsu.

config KSU_DEBUG
	bool "KernelSU debug mode"
	depends on KSU
	default n
	help
	  Enable KernelSU debug mode.

config KSU_DISABLE_MANAGER
	bool "Disable KernelSU manager integration"
	depends on KSU
	default n
	help
	  Disable manager APK detection and manager-specific handling.
	  Root will be used in place of manager-only functionality.

config KSU_DISABLE_POLICY
	bool "Disable KernelSU policy profiles"
	depends on KSU
	default n
	help
	  Disable per-app root/non-root profile customization.
	  Escalation will always use the default full root profile, and
	  non-root handling will follow the global umount policy only.

config KSU_ALLOWLIST_WORKAROUND
	bool "KernelSU allowlist workaround"
	depends on KSU
	default n
	help
	  Enable workaround for broken allowlist save

# For easier extern ifdef handling
config KSU_MANUAL_HOOK
	bool "KernelSU manual hook mode."
	depends on KSU && KSU != m
	default y if !KPROBES
	default n
	help
	  Enable manual hook support.

choice
	prompt "KernelSU dynamic hook mode"
	depends on KSU && !KSU_MANUAL_HOOK
	default KSU_KPROBES_HOOK

config KSU_KPROBES_HOOK
	bool "KernelSU tracepoint+kretprobe hook"
	depends on KRETPROBES && KPROBES && HAVE_SYSCALL_TRACEPOINTS
	help
	  Enable KPROBES, KRETPROBES and TRACEPOINT hook for KernelSU core.
	  This should not be used on kernel below 5.10.

config KSU_SYSCALL_TABLE_HOOK
	bool "KernelSU syscall table patching hook"
	depends on ARM64 || X86_64
	help
	  Patch sys_call_table entries directly to hook syscalls without
	  kprobes or tracepoints. Intended for non-GKI kernels where kprobes
	  are unavailable or non-functional.
	  Requires kernel >= 4.17 (pt_regs-based syscall ABI).

endchoice

endmenu

menu "KernelSU - SUSFS"
config KSU_SUSFS
    bool "KernelSU addon - SUSFS"
    depends on KSU
    default y
    help
      Patch and Enable SUSFS to kernel with KernelSU.

config KSU_SUSFS_HAS_MAGIC_MOUNT
    bool "Say yes if the current KernelSU repo has magic mount implemented (default n)"
    depends on KSU
    default y
    help
      - Enable to indicate that the current SUSFS kernel supports the auto hide features for 5ec1cff's Magic Mount KernelSU
      - Every mounts from /debug_ramdisk/workdir will be treated as magic mount and processed differently by susfs

config KSU_SUSFS_SUS_PATH
    bool "Enable to hide suspicious path (NOT recommended)"
    depends on KSU_SUSFS
    default y
    help
      - Allow hiding the user-defined path and all its sub-paths from various system calls.
      - tmpfs filesystem is not allowed to be added. 
      - Effective only on zygote spawned user app process.
      - Use with cautious as it may cause performance loss and will be vulnerable to side channel attacks,
        just disable this feature if it doesn't work for you or you don't need it at all.

config KSU_SUSFS_SUS_MOUNT
    bool "Enable to hide suspicious mounts"
    depends on KSU_SUSFS
    default y
    help
      - Allow hiding the user-defined mount paths from /proc/self/[mounts|mountinfo|mountstat].
      - Effective on all processes for hiding mount entries.
      - Mounts mounted by process with ksu domain will be forced to be assigned the dev name "KSU".
      - mnt_id and mnt_group_id of the sus mount will be assigned to a much bigger number to solve the issue of id not being contiguous.  

config KSU_SUSFS_AUTO_ADD_SUS_KSU_DEFAULT_MOUNT
    bool "Enable to hide KSU's default mounts automatically (experimental)"
    depends on KSU_SUSFS_SUS_MOUNT
    default y
    help
      - Automatically add KSU's default mounts to sus_mount.
      - No susfs command is needed in userspace.
      - Only mount operation from process with ksu domain will be checked.

config KSU_SUSFS_AUTO_ADD_SUS_BIND_MOUNT
    bool "Enable to hide suspicious bind mounts automatically (experimental)"
    depends on KSU_SUSFS_SUS_MOUNT
    default y
    help
      - Automatically add binded mounts to sus_mount.
      - No susfs command is needed in userspace.
      - Only mount operation from process with ksu domain will be checked.
      - Will also bypass checking mnt_id for /system or /vendor files when doing zygote umount.

config KSU_SUSFS_SUS_KSTAT
    bool "Enable to spoof suspicious kstat"
    depends on KSU_SUSFS
    default y
    help
      - Allow spoofing the kstat of user-defined file/directory.
      - Effective only on non-root user app process.

config KSU_SUSFS_SUS_OVERLAYFS
    bool "Enable to use overlayfs with custom check (NOT recommended)"
    depends on KSU_SUSFS
    default y
    help
      - Turn on custom check for overlayfs so that it can bypass the detection of file modification by third-party.
      - Disable this feature if it causes unwanted issues for you.

config KSU_SUSFS_TRY_UMOUNT
    bool "Enable to try umount custom paths for all newly spawned non-root user app process (NOT recommended)"
    depends on KSU_SUSFS
    default y
    help
      - Allow auto/custom umounting specified paths for all newly spawned non-root user app process.
      - Effective only on non-root user app process.
      - Use with cautious as it may cause performance loss and will be vulnerable to side channel attacks,
        just disable this feature if it doesn't work for you or you don't need it at all.

config KSU_SUSFS_AUTO_ADD_TRY_UMOUNT_FOR_BIND_MOUNT
    bool "Enable to add try umount for all bind mounts automatically (experimental)"
    depends on KSU_SUSFS_TRY_UMOUNT
    default y
    help
      - Automatically add binded mounts to try_umount.
      - No susfs command is needed in userspace.
      - Only mount operation from process with ksu domain will be checked.

config KSU_SUSFS_SPOOF_UNAME
    bool "Enable to spoof uname"
    depends on KSU_SUSFS
    default y
    help
      - Allow spoofing the uname release name.
      - Effective on all processes.

config KSU_SUSFS_ENABLE_LOG
    bool "Enable logging for susfs"
    depends on KSU_SUSFS
    default y
    help
      - Allow logging information to dmesg.

config KSU_SUSFS_HIDE_KSU_SUSFS_SYMBOLS
    bool "Hide ksu and susfs symbols from /proc/kallsyms"
    depends on KSU_SUSFS
    default y
    help
      - Filter out ksu and susfs symbols from /proc/kallsyms.
      - Only effective on non-root processes.

config KSU_SUSFS_SPOOF_CMDLINE_OR_BOOTCONFIG
    bool "Enable to spoof /proc/cmdline or /proc/bootconfig"
    depends on KSU_SUSFS
    default y
    help
      - Allow spoofing the /proc/cmdline or /proc/bootconfig.
      - Effective only on non-root user app process.

config KSU_SUSFS_OPEN_REDIRECT
    bool "Enable to redirect an open system call to another path"
    depends on KSU_SUSFS
    default y
    help
      - Allow redirecting an open system call to another path.
      - Effective only on non-root user app process.

config KSU_SUSFS_SUS_SU
    bool "Enable sus_su to secretly escalate root privileges for specific processes"
    depends on KSU_SUSFS
    default n
    help
      - Allow changing su mode.

config KSU_SUSFS_SUS_MAP
    bool "Enable to hide /proc/[pid]/maps entries (experimental)"
    depends on KSU_SUSFS
    default y
    help
      - Allow hiding user-defined map entries.
      - Effective on zygote spawned non-root user app process.

endmenu
```
